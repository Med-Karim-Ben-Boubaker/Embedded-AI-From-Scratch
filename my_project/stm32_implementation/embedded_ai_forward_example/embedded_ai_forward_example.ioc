# file: embedded_ai_forward_example.ioc
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Mcu.Family=STM32F4
Mcu.Name=STM32F407V(E-G)Tx
Mcu.Package=LQFP100
NVIC.PriorityGroup=NVIC_PRIORITYGROUP_0
ProjectManager.HeapSize=0x200
ProjectManager.StackSize=0x400
ProjectManager.TargetToolchain=STM32CubeIDE
RCC.48MHZClocksFreq_Value=48000000
RCC.AHBFreq_Value=168000000
RCC.APB1CLKDivider=RCC_HCLK_DIV4
RCC.APB1Freq_Value=42000000
RCC.APB1TimFreq_Value=84000000
RCC.APB2CLKDivider=RCC_HCLK_DIV2
RCC.APB2Freq_Value=84000000
RCC.APB2TimFreq_Value=168000000
RCC.CortexFreq_Value=168000000
RCC.HCLKFreq_Value=168000000
RCC.HSE_VALUE=8000000
RCC.HSI_VALUE=16000000
RCC.LSE_VALUE=32768
RCC.PLLM=8
RCC.PLLN=168
RCC.PLLQ=7
RCC.SYSCLKFreq_VALUE=168000000
RCC.SYSCLKSource=RCC_SYSCLKSOURCE_PLLCLK
RCC.VCOOutputFreq_Value=336000000
board=STM32F407G-DISC1

// file: Core/Src/main.c
/* USER CODE BEGIN Header */
/**
  ******************************************************************************
  * @file           : main.c
  * @brief          : Main program body
  ******************************************************************************
  * @attention
  *
  * Copyright (c) 2024 STMicroelectronics.
  * All rights reserved.
  *
  * This software is licensed under terms that can be found in the LICENSE file
  * in the root directory of this software component.
  * If no LICENSE file comes with this software, it is provided AS-IS.
  *
  ******************************************************************************
  */
/* USER CODE END Header */
#include "main.h"

float y_model;
float y_real;

/* USER CODE BEGIN PD */
#define DEBUG_STATE 0
#define INPUT_SIZE  1
#define OUTPUT_SIZE 1
/* USER CODE END PD */

/* USER CODE BEGIN PV */
extern float layer0_weights[16];
extern float layer1_weights[256];
extern float layer2_weights[16];

extern float layer0_biases[16];
extern float layer1_biases[16];
extern float layer2_biases[1];
/* USER CODE END PV */

void SystemClock_Config(void);

int main(void)
{
  /* USER CODE BEGIN 1 */
  int layer0_neurons_num = 16;
  float layer0_outputs[layer0_neurons_num];
  dense_layer_t layer0 = {
		  layer0_weights,
		  layer0_biases,
		  INPUT_SIZE,
		  layer0_neurons_num,
		  relu_activation,
		  layer0_outputs
  };

  // Define the second layer
  int layer1_neurons_num = 16;
  int layer1_input_size = 16;
  float layer1_outputs[layer1_neurons_num];
  dense_layer_t layer1 = {
      layer1_weights,
      layer1_biases,
      layer1_input_size,
      layer1_neurons_num,
      relu_activation,        // Define the activation function ( keep the same architecture as the trained model )
      layer1_outputs
  };

  // Define the third layer
  int layer2_input_number = 16;
  int layer2_neurons_num = 1;
  float layer2_outputs[layer2_neurons_num];
  dense_layer_t layer2 = {
      layer2_weights,
      layer2_biases,
      layer2_input_number,
      layer2_neurons_num,
      linear_activation,      // Define the activation function ( keep the same architecture as the trained model )
      layer2_outputs
  };

  // define number of layers and the layers array
    int layers_num = 3;
    dense_layer_t layers[3] = { layer0, layer1, layer2 };

    // Define an input array
    float input[INPUT_SIZE];

    // Define the output array
    float output[OUTPUT_SIZE];

    // Define the model
    model_t model;
    model.init = model_init;
    model.init(&model, layers, layers_num);

  /* USER CODE END 1 */

  /* MCU Configuration--------------------------------------------------------*/

  /* Reset of all peripherals, Initializes the Flash interface and the Systick. */
  HAL_Init();

  /* Configure the system clock */
  SystemClock_Config();

  /* Initialize all configured peripherals */
  /* USER CODE BEGIN 2 */

  // Testing the sin wave model
#ifdef DEBUG_STATE
  for (int i = 0; i < 6; i++) {
	  input[0] = 10;
	  model.predict(&model, input, output);
  }
#endif
  /* USER CODE END 2 */
  float x = 0;
  /* Infinite loop */
  while (1)
  {

    /* USER CODE BEGIN 3 */
	  y_real = sin(x);
	  model.predict(&model, &x, &y_model);
	  HAL_Delay(500);

	  if ( x > 6 ){
		  x = 0;
	  }
	  else {
		  x++;
	  }
  }
  /* USER CODE END 3 */
}

void SystemClock_Config(void)
{
  RCC_OscInitTypeDef RCC_OscInitStruct = {0};
  RCC_ClkInitTypeDef RCC_ClkInitStruct = {0};

  /** Configure the main internal regulator output voltage
  */
  __HAL_RCC_PWR_CLK_ENABLE();
  __HAL_PWR_VOLTAGESCALING_CONFIG(PWR_REGULATOR_VOLTAGE_SCALE1);

  /** Initializes the RCC Oscillators according to the specified parameters
  * in the RCC_OscInitTypeDef structure.
  */
  RCC_OscInitStruct.OscillatorType = RCC_OSCILLATORTYPE_HSI;
  RCC_OscInitStruct.HSIState = RCC_HSI_ON;
  RCC_OscInitStruct.HSICalibrationValue = RCC_HSICALIBRATION_DEFAULT;
  RCC_OscInitStruct.PLL.PLLState = RCC_PLL_ON;
  RCC_OscInitStruct.PLL.PLLSource = RCC_PLLSOURCE_HSI;
  RCC_OscInitStruct.PLL.PLLM = 8;
  RCC_OscInitStruct.PLL.PLLN = 168;
  RCC_OscInitStruct.PLL.PLLP = RCC_PLLP_DIV2;
  RCC_OscInitStruct.PLL.PLLQ = 7;
  if (HAL_RCC_OscConfig(&RCC_OscInitStruct) != HAL_OK)
  {
    Error_Handler();
  }

  /** Initializes the CPU, AHB and APB buses clocks
  */
  RCC_ClkInitStruct.ClockType = RCC_CLOCKTYPE_HCLK|RCC_CLOCKTYPE_SYSCLK
                              |RCC_CLOCKTYPE_PCLK1|RCC_CLOCKTYPE_PCLK2;
  RCC_ClkInitStruct.SYSCLKSource = RCC_SYSCLKSOURCE_PLLCLK;
  RCC_ClkInitStruct.AHBCLKDivider = RCC_SYSCLK_DIV1;
  RCC_ClkInitStruct.APB1CLKDivider = RCC_HCLK_DIV4;
  RCC_ClkInitStruct.APB2CLKDivider = RCC_HCLK_DIV2;

  if (HAL_RCC_ClockConfig(&RCC_ClkInitStruct, FLASH_LATENCY_5) != HAL_OK)
  {
    Error_Handler();
  }
}

void Error_Handler(void)
{
  __disable_irq();
  while (1)
  {
  }
}
